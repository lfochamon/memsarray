/****************************************************/
/* Device tree overlay for Chamon's mic array       */
/* WARNING! Disable HDMI before loading the overlay */
/****************************************************/

/* PIN USE   PIN     PIN HEADER  PINCTRL ADDRESS  MODE  I/O    */
/* CLK       PRU1_5  P8_42       0x0b4            5     OUTPUT */
/* MIC1      PRU1_3  P8_44       0x0ac            6     INPUT  */
/* MIC2      PRU1_1  P8_46       0x0a4            6     INPUT  */

/dts-v1/;
/plugin/;

/ {
    compatible = "ti,beaglebone", "ti,beaglebone-black";

    part-number = "MEMS-ARRAY";
    version = "00A0";

    /* This overlay uses the following resources */
    exclusive-use =
        "P8.42", "P8.44", "P8.46", "pru0", "pru1";

    fragment@0 {
        target = <&am33xx_pinmux>;

        __overlay__ {

            pru_pru_pins: pinmux_pru_pru_pins {   // PRU pin settings
                pinctrl-single,pins = <
                    0x0b4 0x05    /* PRU1_5, P8_42, MODE 5, OUTPUT */
                    0x0ac 0x26    /* PRU1_3, P8_44, MODE 6, INPUT  */
                    0x0a4 0x26    /* PRU1_1, P8_46, MODE 6, INPUT  */
                >;
            };
        };
    };

    fragment@1 {         // Enable PRU
        target = <&pruss>;
        __overlay__ {
            status = "okay";
            pinctrl-names = "default";
            pinctrl-0 = <&pru_pru_pins>;
        };
    };
};


/*
BIT 6 Slew Control: Fast = 0, Slow = 1
BIT 5 Output = 0, Input = 1.
BIT 4 Pull‐down = 0, Pull‐up = 1.
BIT 3 Internal pull‐up/down: Enable = 0, Disable = 1.
BIT 2,1,0: pin mode
*/
